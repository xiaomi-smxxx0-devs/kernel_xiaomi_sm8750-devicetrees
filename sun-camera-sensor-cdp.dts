/dts-v1/;
/plugin/;

#include <dt-bindings/clock/qcom,gcc-sun.h>
#include <dt-bindings/clock/qcom,camcc-sun.h>
#include <dt-bindings/clock/qcom,cambistmclkcc-sun.h>
#include <dt-bindings/interconnect/qcom,sun.h>
#include <dt-bindings/interrupt-controller/arm-gic.h>
#include <dt-bindings/regulator/qcom,rpmh-regulator-levels.h>

#include "sun-camera-sensor-cdp.dtsi"
/ {
	model = "Qualcomm Technologies, Inc. Sun CDP/RCM";
	compatible = "qcom,sun-cdp", "qcom,sun", "qcom,cdp", "qcom,rcm", "qcom,sun-rcm";
	qcom,msm-id = <618 0x10000>, <618 0x20000>;
	qcom,board-id = <1 0>, <21 0>;
};
