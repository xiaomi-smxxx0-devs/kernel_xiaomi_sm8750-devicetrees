// SPDX-License-Identifier: BSD-3-Clause

/*
 * Copyright (c) 2024 Qualcomm Innovation Center, Inc. All rights reserved.
 */

/dts-v1/;
/plugin/;

#include "canoe-peach-cnss.dtsi"

/ {
	model = "Qualcomm Technologies, Inc. Canoe SoCs";
	compatible = "qcom,canoe", "qcom,canoep";
	qcom,msm-id = <0x10294 0x10000>, <0x10294 0x20000>, <0x10295 0x10000>, <0x10295 0x20000>,
		      <0x30294 0x10000>, <0x30294 0x20000>, <0x30295 0x10000>, <0x30295 0x20000>,
		      <0x1010294 0x10000>, <0x1010294 0x20000>, <0x1010295 0x10000>,
		      <0x1010295 0x20000>, <0x1030294 0x10000>, <0x1030294 0x20000>,
		      <0x1030295 0x10000>, <0x1030295 0x20000>;
	qcom,board-id = <1 0>, <8 0>, <0x10021 0>, <11 0>, <0x15 0>, <0x208 0>, <0x108 0>;
};
