/dts-v1/;
/plugin/;

#include <dt-bindings/interrupt-controller/arm-gic.h>
#include <dt-bindings/soc/qcom,ipcc.h>
#include <dt-bindings/interconnect/qcom,sun.h>
#include <dt-bindings/clock/qcom,gcc-sun.h>
#include <dt-bindings/clock/qcom,rpmh.h>
#include "sun-ipa.dtsi"

/ {
	model = "Qualcomm Technologies, Inc. Sun SOC";
	compatible = "qcom,sun";
	qcom,msm-id = <618 0x10000>, <618 0x20000>;
	qcom,board-id = <0 0>;
};
