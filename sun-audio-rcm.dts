// SPDX-License-Identifier: BSD-3-Clause
/*
 * Copyright (c) 2023 Qualcomm Innovation Center, Inc. All rights reserved.
 */

/dts-v1/;
/plugin/;

#include "sun-audio-cdp.dtsi"
 / {
	model = "Qualcomm Technologies, Inc. Sun RCM";
	compatible = "qcom,sun-rcm", "qcom,sun", "qcom,sunp-rcm", "qcom,sunp", "qcom,rcm";
	qcom,msm-id = <618 0x10000>, <618 0x20000>;
	qcom,board-id = <0x15 0>;
};
