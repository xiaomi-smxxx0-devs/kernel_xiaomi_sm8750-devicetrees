// SPDX-License-Identifier: BSD-3-Clause
/*
 * Copyright (c) 2023 Qualcomm Innovation Center, Inc. All rights reserved.
 */

#include "sun-audio-qrd.dtsi"

&sun_snd {
	qcom,model = "sun-qrd-sku2-snd-card";
};
