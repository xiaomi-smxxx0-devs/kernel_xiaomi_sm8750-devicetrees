// SPDX-License-Identifier: BSD-3-Clause
/*
 * Copyright (c) 2024 Qualcomm Innovation Center, Inc. All rights reserved.
 */

#include "tuna-pmiv0108.dtsi"

&pmiv010x_amoled {
	status= "ok";
};

&pmiv010x_amoled_ecm {
	status = "ok";
};
