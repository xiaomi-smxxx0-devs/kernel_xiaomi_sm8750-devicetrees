// SPDX-License-Identifier: BSD-3-Clause
/*
 * Copyright (c) 2024 Qualcomm Innovation Center, Inc. All rights reserved.
 */

#include <dt-bindings/clock/qcom,sdx75-gcc.h>

&soc {
	usb: ssusb@a600000 {
		compatible = "qcom,dwc-usb3-msm";
		reg = <0x0 0xa600000 0x0 0x100000>;
		reg-names = "core_base";

		#address-cells = <2>;
		#size-cells = <2>;
		ranges;

		interrupts-extended = <&intc GIC_SPI 130 IRQ_TYPE_LEVEL_HIGH>,
			<&pdc 10 IRQ_TYPE_EDGE_RISING>,
			<&pdc 9 IRQ_TYPE_EDGE_RISING>,
			<&pdc 17 IRQ_TYPE_LEVEL_HIGH>;
		interrupt-names = "pwr_event_irq", "dp_hs_phy_irq",
				"dm_hs_phy_irq", "ss_phy_irq";
		qcom,use-pdc-interrupts;

		USB3_GDSC-supply = <&gcc_usb30_gdsc>;
		clocks = <&gcc GCC_USB30_MASTER_CLK>,
			<&gcc GCC_USB30_SLV_AHB_CLK>,
			<&gcc GCC_USB30_MSTR_AXI_CLK>,
			<&gcc GCC_USB30_MOCK_UTMI_CLK>,
			<&gcc GCC_USB30_SLEEP_CLK>;
		clock-names = "core_clk", "iface_clk",
					"bus_aggr_clk", "utmi_clk",
					"sleep_clk";

		resets = <&gcc GCC_USB30_BCR>;
		reset-names = "core_reset";

		qcom,sleep-clk-bcr;
		qcom,core-clk-rate = <200000000>;
		qcom,core-clk-rate-hs = <66666667>;
		qcom,core-clk-rate-disconnected = <133333333>;

		dwc3: dwc3@a600000 {
			compatible = "snps,dwc3";
			reg = <0x0 0xa600000 0x0 0xd93c>;
			interrupts = <GIC_SPI 133 IRQ_TYPE_LEVEL_HIGH>;
			usb-phy = <&usb_nop_phy>, <&usb_nop_phy>;
			snps,has-lpm-erratum;
			snps,is-utmi-l1-suspend;
			snps,dis-u1-entry-quirk;
			snps,dis-u2-entry-quirk;
			snps,dis_u2_susphy_quirk;
			snps,hird-threshold = /bits/ 8 <0x10>;
			tx-fifo-resize;
			/* set host mode interrupt moderation to 1 us */
			imod-interval-ns = <1000>;
			maximum-speed = "super-speed-plus";
			usb-role-switch;
			dr_mode = "peripheral";
		};

	};

	usb_nop_phy: usb_nop_phy {
		compatible = "usb-nop-xceiv";
	};
};
