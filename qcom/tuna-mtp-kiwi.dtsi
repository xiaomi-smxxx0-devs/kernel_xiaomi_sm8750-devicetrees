// SPDX-License-Identifier: BSD-3-Clause
/*
 * Copyright (c) 2024 Qualcomm Innovation Center, Inc. All rights reserved.
 */

#include "tuna-mtp.dtsi"

&S1G_ALT {
	status = "ok";
};

&L3G {
	regulator-always-on;
};
