// SPDX-License-Identifier: BSD-3-Clause
/*
 * Copyright (c) 2024 Qualcomm Innovation Center, Inc. All rights reserved.
 */

#include "tuna.dtsi"
/ {
	model = "Qualcomm Technologies, Inc. Tuna 7";
	compatible = "qcom,tuna";
	qcom,msm-id = <681 0x10000>;
};
