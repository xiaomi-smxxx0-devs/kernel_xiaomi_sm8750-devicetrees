// SPDX-License-Identifier: BSD-3-Clause
/*
 * Copyright (c) 2025 Qualcomm Innovation Center, Inc. All rights reserved.
 */

#include <dt-bindings/gpio/gpio.h>
#include <dt-bindings/iio/qcom,spmi-vadc.h>
#include <dt-bindings/input/input.h>

/ {
	model = "Qualcomm Technologies, Inc. QCS610 IOT";
	compatible = "qcom,qcs610-iot", "qcom,qcs610", "qcom,iot";
	qcom,board-id = <32 0>;
};
