// SPDX-License-Identifier: BSD-3-Clause

/*
 * Copyright (c) 2024 Qualcomm Innovation Center, Inc. All rights reserved.
 */

/dts-v1/;
/plugin/;

#include "canoe-kiwi-cnss.dtsi"

/ {
	model = "Qualcomm Technologies, Inc. Canoe SoCs";
	compatible = "qcom,canoe", "qcom,canoep", "qcom,canoe-mtp", "qcom,canoe-cdp";
	qcom,msm-id = <0x10294 0x10000>, <0x10294 0x20000>, <0x10295 0x10000>, <0x10295 0x20000>,
			<0x30294 0x10000>, <0x30294 0x20000>, <0x30295 0x10000>, <0x30295 0x20000>,
			<0x1010294 0x10000>, <0x1010294 0x20000>, <0x1010295 0x10000>,
			<0x1010295 0x20000>, <0x1030294 0x10000>, <0x1030294 0x20000>,
			<0x1030295 0x10000>, <0x1030295 0x20000>;
	qcom,board-id = <0x1000001 0>, <0x1000008 0>, <0x1000015 0>;
};
